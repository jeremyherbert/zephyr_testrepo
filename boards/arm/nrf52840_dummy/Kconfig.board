## boards/arm/nrf52840_dummy/Kconfig.board
```kconfig
# Copyright (c) 2021 Nordic Semiconductor ASA
# SPDX-License-Identifier: Apache-2.0

config BOARD_NRF52840_DUMMY
	bool "Custom nRF52840 dummy board"
	depends on SOC_NRF52840_QIAA
```

## boards/arm/nrf52840_dummy/Kconfig.defconfig
```kconfig
# Copyright (c) 2021 Nordic Semiconductor ASA
# SPDX-License-Identifier: Apache-2.0

if BOARD_NRF52840_DUMMY

config BOARD
	default "nrf52840_dummy"

endif # BOARD_NRF52840_DUMMY
```

## drivers/sensor/dummyaccel/Kconfig
```kconfig
config DUMMYACCEL
	bool "Dummy Accelerometer"
	help
	  Enable dummy accelerometer sensor
```
